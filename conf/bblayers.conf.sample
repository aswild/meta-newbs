## conf/bblayers.conf.sample
```bitbake
# LAYER_CONF_VERSION is increased each time build/conf/bblayers.conf
# changes incompatibly
LCONF_VERSION = "5"

BBPATH = "${TOPDIR}"
BBFILES ?= ""

BBLAYERS ?= ##OEROOT##/meta"
BBLAYERS += "##NEWBSROOT##/meta-openembedded/meta-oe"
BBLAYERS += "##NEWBSROOT##/meta-openembedded/meta-filesystems"
BBLAYERS += "##NEWBSROOT##/meta-raspberrypi"

BBLAYERS += "##NEWBSROOT##/meta-wild-common"
BBLAYERS += "##NEWBSROOT##/meta-newbs"

BBLAYERS_NON_REMOVABLE ?= "##OEROOT##/meta"
"
```

## conf/distro/include/newbs-base.inc
```bitbake
# NEWBS distro configuration
# vim: ft=bitbake

require conf/distro/wild-generic.conf

# mask dangling appends in meta-raspberrypi
BBMASK += " \
    meta-raspberrypi/recipes-multimedia/gstreamer/.* \
    meta-raspberrypi/recipes-bsp/u-boot/.* \
    meta-raspberrypi/dynamic-layers/meta-python/recipes-connectivity/lirc/.* \
"

# enable licenses
LICENSE_FLAGS_ACCEPTED += "synaptics-killswitch"

# DISTRO_FEATURES_DEFAULT, minus some things
DISTRO_FEATURES = "acl argp ext2 ipv4 ipv6 largefile pci usbhost wifi xattr"

# extra features
DISTRO_FEATURES += "pam usrmerge"

# remove unwanted machine features from meta-raspberrypi
MACHINE_FEATURES:remove = "apm touchscreen alsa bluetooth"

# remove misc recommended packages I don't want
BAD_RECOMMENDATIONS = "vim-tutor"

# don't make /var/log a symlink to /var/volatile/log, we'll handle it manually
# with a bind mount to /home/log (if it exists) or /var/volatile/log (which we'll make)
FILESYSTEM_PERMS_TABLES:remove = "files/fs-perms-volatile-log.txt"

# disable tcmalloc on mongodb, it causes segfaults in dunfell for reasons I don't care to debug
PACKAGECONFIG:remove:pn-mongodb = "tcmalloc"

# disable lmsensors sensord, it pulls in heavy GUI libraries
PACKAGECONFIG:remove:pn-lmsensors = "sensord"
PACKAGECONFIG:remove:pn-lmsensors-config = "sensord"

##### Kernel stuff #####
PREFERRED_PROVIDER_virtual/kernel = "linux-raspberrypi-newbs"
PREFERRED_VERSION_linux-raspberrypi-newbs ?= "6.12%"
KERNEL_IMAGETYPE:arm = "zImage"
KERNEL_IMAGETYPE:aarch64 = "Image"
DTB_DEPLOYDIR = "dtb"

# kernel commandline
NEWBS_ROOT ?= "/dev/mmcblk0p2"

# use systemd net naming scheme v251 to avoid renaming "eth0" into "end0". See systemd.net-naming-scheme(7)
NEWBS_CMDLINE = "console=tty1 console=serial0,115200 root=${NEWBS_ROOT} rootwait earlyprintk net.naming-scheme=v251"
NEWBS_CMDLINE:append:debug = " debug"
SERIAL_CONSOLES = "115200;ttyAMA0"

# kernel device tree
# KERNEL_DEVICETREE is populated from RPI_KERNEL_DEVICETREE and RPI_KERNEL_DEVICETREE_OVERLAYS
# in meta-raspberrypi. KERNEL_DEVICETREE should be populated by the machine config, but customize
# included overlays for newbs here.

# Use only the RPi 4 B dtb, not RPi 400 and CM4
RPI_KERNEL_DEVICETREE:raspberrypi4-64 = "broadcom/bcm2711-rpi-4-b.dtb"
# Same for RPi 5
RPI_KERNEL_DEVICETREE:raspberrypi5 = "broadcom/bcm2712-rpi-5-b.dtb"

NEOSTRIP_OVERLAYS = " \
    overlays/spi0-shiftbrite.dtbo \
    overlays/spi1-shiftbrite.dtbo \
    overlays/spi0-neostrip.dtbo \
    overlays/spi1-neostrip.dtbo \
"

RPI_KERNEL_DEVICETREE_OVERLAYS = " \
    overlays/disable-bt.dtbo \
    overlays/i2c1.dtbo \
    overlays/miniuart-bt.dtbo \
    ${@bb.utils.contains('KERNEL_FEATURES', 'neostrip', '${NEOSTRIP_OVERLAYS}', '', d)} \
"

EXTRA_CONFIG_TXT:append = "${@bb.utils.contains('KERNEL_FEATURES', 'neostrip', \
                             'dtoverlay=spi0-neostrip\ndtparam=neostrip0_length=8\n', '', d)}"


##### Image stuff #####
IMAGE_CLASSES = "newbs-bootimg nimage"
IMAGE_FSTYPES = "ext4 squashfs-zst newbs-bootimg nimage"
IMAGE_FEATURES += "read-only-rootfs"
```

## conf/distro/newbs-base.inc
```bitbake
# NEWBS distro configuration

##### Yocto Configuration #####

# don't append -glibc to TMPDIR
TCLIBCAPPEND = ""

# don't fail because of dangling appends
BB_DANGLINGAPPENDS_WARNONLY = "1"

BBMASK ?= "fake-bbmask-string-that-wont-match-anything"

# mask dangling appends in meta-raspberrypi
BBMASK .= "|meta-raspberrypi/recipes-multimedia/gstreamer/.*"

# selectively mask some recipes that should only be build for certain distros
BBMASK_MCE = "|meta-newbs/recipes-multimedia/kodi/.*|meta-newbs/recipes-core/images/newbs-mce-image\.bb"
BBMASK_UNIFI = "|meta-newbs/recipes-unifi/.*|meta-newbs/recipes-core/images/newbs-unifi-image\.bb"
BBMASK .= "${@bb.utils.contains('DISTRO', 'newbs-mce', '', '${BBMASK_MCE}', d)}"
BBMASK .= "${@bb.utils.contains('DISTRO', 'newbs-unifi', '', '${BBMASK_UNIFI}', d)}"

##### Kernel stuff #####
PREFERRED_PROVIDER_virtual/kernel = "linux-raspberrypi-newbs"
PREFERRED_VERSION_linux-raspberrypi-newbs ?= "4.19%"
KERNEL_IMAGETYPE_arm = "zImage"
KERNEL_IMAGETYPE_aarch64 = "Image"
DTB_DEPLOYDIR = "dtb"

# kernel commandline
NEWBS_ROOT ?= "/dev/mmcblk0p2"
NEWBS_ROOT_TYPE ?= "squashfs-xz"
# FIXME systemd breaks and kernel panics if console=tty1 and no HDMI connected
#CMDLINE = "dwc_otg.lpm_enable=0 console=tty1 console=serial0,115200 root=${NEWBS_ROOT} rootwait earlyprintk"
CMDLINE = "dwc_otg.lpm_enable=0 console=serial0,115200 root=${NEWBS_ROOT} rootwait earlyprintk"
CMDLINE_append_debug = " debug"
SERIAL_CONSOLE = "115200 ttyAMA0"

# kernel device tree
SYSDTB ??= ""
SYSDTB_raspberrypi2 = "bcm2709-rpi-2-b.dtb"
SYSDTB_raspberrypi3 = "broadcom/bcm2710-rpi-3-b.dtb \
                       broadcom/bcm2710-rpi-3-b-plus.dtb"
DTOVERLAYS ??= ""
NEOSTRIP_OVERLAYS = " \
    overlays/spi0-shiftbrite.dtbo \
    overlays/spi1-shiftbrite.dtbo \
    overlays/spi0-neostrip.dtbo \
    overlays/spi1-neostrip.dtbo \
"
DTOVERLAYS_raspberrypi3 = " \
    overlays/pi3-disable-bt.dtbo \
    overlays/pi3-miniuart-bt.dtbo \
    ${@bb.utils.contains('KERNEL_FEATURES', 'neostrip', '${NEOSTRIP_OVERLAYS}', '', d)} \
"
KERNEL_DEVICETREE = " \
    ${SYSDTB} \
    ${DTOVERLAYS} \
"

EXTRA_CONFIG_TXT_append = "${@bb.utils.contains('KERNEL_FEATURES', 'neostrip', \
                             'dtoverlay=spi0-neostrip\ndtparam=neostrip0_length=8\n', '', d)}"

##### Root FS stuff #####
DISTRO_FEATURES += " \
    ipv6 \
    ld-is-gold \
    pam \
    usbhost \
    usrmerge \
"

# add wifi to rpi3 distro
DISTRO_FEATURES_append_raspberrypi3 = " wifi"

# remove unwanted machine features from meta-raspberrypi
MACHINE_FEATURES_remove = "apm touchscreen alsa bluetooth"

# remove misc recommended packages I don't want
BAD_RECOMMENDATIONS = "vim-tutor"

NCURSES_ABI_VERSION = "6"

# Enable systemd
DISTRO_FEATURES_BACKFILL_CONSIDERED += "sysvinit"
DISTRO_FEATURES += "systemd"
VIRTUAL-RUNTIME_init_manager = "systemd"

# locales
GLIBC_GENERATE_LOCALES = "en_US.UTF-8"
IMAGE_LINGUAS = "en-us"
DISTRO_FEATURES += "libc-locales libc-charsets libc-locale-code"

##### Image stuff #####
IMAGE_CLASSES = "nimage image-buildinfo"
IMAGE_FSTYPES = "ext4 squashfs-xz nimage"
IMAGE_FEATURES += " \
    read-only-rootfs \
"
```

## conf/distro/newbs-mce.conf
```bitbake
# Newbs Media Center Edition distro config

require conf/distro/include/newbs-base.inc

DISTRO_NAME = "NEWBS MCE"
DISTRO_VERSION = "0.1"

DISTRO_FEATURES += " \
    opengl \
    pam \
    wayland \
"

EXTRA_CONFIG_TXT_append = "gpu_mem=256\n"

# Allow ffmpeg to build
LICENSE_FLAGS_WHITELIST += "commercial"

# meta-openembedded has kodi 17 but we want kodi 18 from meta-kodi
PREFERRED_VERSION_kodi = "18%"
```

## conf/distro/newbs-unifi.conf
```bitbake
# NEWBS UniFi Controller distro config

require conf/distro/include/newbs-base.inc

DISTRO_NAME = "NEWBS UniFi"
DISTRO_VERSION = "1.2"
DISTRO_CODENAME = "${LAYERSERIES_COMPAT_newbs}"

DISTRO_FEATURES_BACKFILL_CONSIDERED += "pulseaudio"

# disable empty root password
IMAGE_FEATURES:remove = "debug-tweaks"

# maximize CPU memory on Pi3 since we don't use the GPU
# and the Unifi controller is pretty memory-hungry
EXTRA_CONFIG_TXT:append:raspberrypi3 = "\
gpu_mem=16\n\
start_file=start_cd.elf\n\
fixup_file=fixup_cd.dat"

# Disable x11 in Java, we only need headless. Target Java is already implicitly headless because
# target DISTRO_FEATURES doesn't include x11 for newbs.
PACKAGECONFIG:remove:pn-openjdk-8-native = "x11"
PACKAGECONFIG:remove:pn-icedtea7-native = "x11"
# these icedtea deps should be PACKAGECONFIG based, but are also included unconditionally
DEPENDS:remove:pn-icedtea7-native = "libx11-native xorgproto-native"

# Stick with mongodb 4.4 - it builds much faster and is half the binary size than mongodb 7.0
PREFERRED_PROVIDER_mongodb = "mongodb"
```

## conf/distro/newbs-x11.conf
```bitbake
# NEWBS distro configuration with X11 support.
# Tuned for headless images with x11 client support, not GUI system.

require conf/distro/newbs.conf

DISTRO_NAME = "NEWBS X11"

DISTRO_FEATURES += "x11"
DISTRO_FEATURES_BACKFILL_CONSIDERED:remove = "pulseaudio"
```

## conf/distro/newbs.conf
```bitbake
# NEWBS distro configuration

require conf/distro/include/newbs-base.inc

##### Yocto Configuration #####

DISTRO_NAME = "NEWBS"
DISTRO_VERSION = "0.6"

DISTRO_FEATURES_remove = "x11"
DISTRO_FEATURES_BACKFILL_CONSIDERED += "pulseaudio"

##### Init stuff #####
#INITRAMFS_IMAGE ?= "newbs-init-image"
INITRAMFS_IMAGE ?= ""
INITRAMFS_FSTYPES ?= "cpio.xz"
INITRAMFS_IMAGE_BUNDLE ?= "0"
NEWBS_INIT_DEST = "newbs-init.${INITRAMFS_FSTYPES}"

##### Image stuff #####
IMAGE_FEATURES += " \
    doc-pkgs \
"
```

## conf/layer.conf
```bitbake
# prepend to BBPATH
BBPATH .= ":${LAYERDIR}"

BBFILES += "${LAYERDIR}/recipes*/*/*.bb \
            ${LAYERDIR}/recipes*/*/*.bbappend"

BBFILES_DYNAMIC += " \
    meta-kodi:${LAYERDIR}/dynamic-layers/meta-kodi/recipes-*/*/*.bbappend \
"

BBFILE_COLLECTIONS += "newbs"
BBFILE_PATTERN_newbs := "^${LAYERDIR}/"
BBFILE_PRIORITY_newbs = "11"

LAYERDEPENDS_newbs = "raspberrypi wild-common"
LAYERSERIES_COMPAT_newbs = "sumo thud warrior"

LICENSE_PATH += "${LAYERDIR}/custom-licenses"
```

## conf/machine/include/arm/arch-armv8-a.inc
```bitbake
require conf/machine/include/arm/arch-arm64.inc

TUNEVALID[armv8] = "Enable instructions for ARMv8"
TUNECONFLICTS[armv8] = "armv4 armv5 armv6 armv7 armv7a armv7ve"

TUNE_CCARGS .= " \
${@' -march=armv8-a+crypto+crc' if bb.utils.contains('TUNE_FEATURES', [ 'armv8', 'cryptov8', 'crcv8' ], True, False, d) else \
' -march=armv8-a+crypto' if bb.utils.contains('TUNE_FEATURES', [ 'armv8', 'cryptov8' ], True, False, d) else \
' -march=armv8-a+crc' if bb.utils.contains('TUNE_FEATURES', [ 'armv8', 'crcv8' ], True, False, d) else \
bb.utils.contains('TUNE_FEATURES', 'armv8', ' -march=armv8-a', '', d)}"

TUNE_CCARGS_MFPU .= "\
${@' crypto-neon-fp-armv8' if bb.utils.contains('TUNE_FEATURES', [ 'armv8', 'neon', 'cryptov8' ], True, False, d) else \
' neon-fp-armv8' if bb.utils.contains('TUNE_FEATURES', [ 'armv8', 'neon' ], True, False, d) else \
bb.utils.contains('TUNE_FEATURES', [ 'armv8' ], ' fp-armv8', '', d)}"

MACHINEOVERRIDES =. "${@bb.utils.contains('TUNE_FEATURES', 'armv8', 'armv8:', '' ,d)}"

AVAILTUNES += "armv8 armv8-crypto armv8-crc armv8-crypto-crc"
TUNE_FEATURES_tune-armv8 = "armv8"
TUNE_FEATURES_tune-armv8-crypto = "${TUNE_FEATURES_tune-armv8} cryptov8"
TUNE_FEATURES_tune-armv8-crc = "${TUNE_FEATURES_tune-armv8} crcv8"
TUNE_FEATURES_tune-armv8-crypto-crc = "${TUNE_FEATURES_tune-armv8} cryptov8 crcv8"
PACKAGE_EXTRA_ARCHS_tune-armv8 = "armv8"
PACKAGE_EXTRA_ARCHS_tune-armv8-crypto = "${PACKAGE_EXTRA_ARCHS_tune-armv8} armv8-crypto"
PACKAGE_EXTRA_ARCHS_tune-armv8-crc = "${PACKAGE_EXTRA_ARCHS_tune-armv8} armv8-crc"
PACKAGE_EXTRA_ARCHS_tune-armv8-crypto-crc = "${PACKAGE_EXTRA_ARCHS_tune-armv8} armv8-crypto-crc"

AVAILTUNES += "armv8-neon armv8-neon-crypto armv8-neon-crc armv8-neon-crypto-crc"
TUNE_FEATURES_tune-armv8-neon = "${TUNE_FEATURES_tune-armv8} neon"
TUNE_FEATURES_tune-armv8-neon-crypto = "${TUNE_FEATURES_tune-armv8-crypto} neon"
TUNE_FEATURES_tune-armv8-neon-crc = "${TUNE_FEATURES_tune-armv8-crc} neon"
TUNE_FEATURES_tune-armv8-neon-crypto-crc = "${TUNE_FEATURES_tune-armv8-crypto-crc} neon"
PACKAGE_EXTRA_ARCHS_tune-armv8-neon = "${PACKAGE_EXTRA_ARCHS_tune-armv8} armv8-neon"
PACKAGE_EXTRA_ARCHS_tune-armv8-neon-crypto = "${PACKAGE_EXTRA_ARCHS_tune-armv8-crypto} armv8-neon-crypto"
PACKAGE_EXTRA_ARCHS_tune-armv8-neon-crc = "${PACKAGE_EXTRA_ARCHS_tune-armv8-crc} armv8-neon-crc"
PACKAGE_EXTRA_ARCHS_tune-armv8-neon-crypto-crc = "${PACKAGE_EXTRA_ARCHS_tune-armv8-crypto-crc} armv8-neon-crypto-crc"

AVAILTUNES += "armv8hf armv8hf-crypto armv8hf-crc armv8hf-crypto-crc"
TUNE_FEATURES_tune-armv8hf = "${TUNE_FEATURES_tune-armv8} callconvention-hard"
TUNE_FEATURES_tune-armv8hf-crypto = "${TUNE_FEATURES_tune-armv8-crypto} callconvention-hard"
TUNE_FEATURES_tune-armv8hf-crc = "${TUNE_FEATURES_tune-armv8-crc} callconvention-hard"
TUNE_FEATURES_tune-armv8hf-crypto-crc = "${TUNE_FEATURES_tune-armv8-crypto-crc} callconvention-hard"
PACKAGE_EXTRA_ARCHS_tune-armv8hf = "armv8hf"
PACKAGE_EXTRA_ARCHS_tune-armv8hf-crypto = "${PACKAGE_EXTRA_ARCHS_tune-armv8hf} armv8hf-crypto"
PACKAGE_EXTRA_ARCHS_tune-armv8hf-crc = "${PACKAGE_EXTRA_ARCHS_tune-armv8hf} armv8hf-crc"
PACKAGE_EXTRA_ARCHS_tune-armv8hf-crypto-crc = "${PACKAGE_EXTRA_ARCHS_tune-armv8hf} armv8hf-crypto-crc"

AVAILTUNES += "armv8hf-neon armv8hf-neon-crypto armv8hf-neon-crc armv8hf-neon-crypto-crc"
TUNE_FEATURES_tune-armv8hf-neon = "${TUNE_FEATURES_tune-armv8hf} neon"
TUNE_FEATURES_tune-armv8hf-neon-crypto = "${TUNE_FEATURES_tune-armv8hf-crypto} neon"
TUNE_FEATURES_tune-armv8hf-neon-crc = "${TUNE_FEATURES_tune-armv8hf-crc} neon"
TUNE_FEATURES_tune-armv8hf-neon-crypto-crc = "${TUNE_FEATURES_tune-armv8hf-crypto-crc} neon"
PACKAGE_EXTRA_ARCHS_tune-armv8hf-neon = "${PACKAGE_EXTRA_ARCHS_tune-armv8hf} armv8hf-neon"
PACKAGE_EXTRA_ARCHS_tune-armv8hf-neon-crypto = "${PACKAGE_EXTRA_ARCHS_tune-armv8hf-crypto} armv8hf-neon-crypto"
PACKAGE_EXTRA_ARCHS_tune-armv8hf-neon-crc = "${PACKAGE_EXTRA_ARCHS_tune-armv8hf-crc} armv8hf-neon-crc"
PACKAGE_EXTRA_ARCHS_tune-armv8hf-neon-crypto-crc = "${PACKAGE_EXTRA_ARCHS_tune-armv8hf-crypto-crc} armv8hf-neon-crypto-crc"

TUNEVALID[cryptov8] = "Enable armv8 crypto extensions"
TUNEVALID[crcv8] = "Enable armv8 crc extensions"
```

## conf/machine/raspberrypi3-a53.conf
```bitbake
#@TYPE: Machine
#@NAME: RaspberryPi 3 Development Board
#@DESCRIPTION: Machine configuration for the RaspberryPi 3

MACHINEOVERRIDES = "raspberrypi3:${MACHINE}"

DEFAULTTUNE ?= "cortexa53hf-32"
require conf/machine/include/tune-cortexa53.inc
include conf/machine/include/rpi-base.inc

MACHINE_EXTRA_RRECOMMENDS += "linux-firmware-raspbian-bcm43430 linux-firmware-raspbian-bcm43455"

SDIMG_KERNELIMAGE ?= "kernel7.img"
UBOOT_MACHINE = "rpi_3_32b_config"
SERIAL_CONSOLE ?= "115200 ttyS0"
VC4_CMA_SIZE ?= "cma-256"
```
